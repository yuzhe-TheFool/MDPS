## sdkconfig.defaults
```kconfig
# 目标芯片 ESP32-S3
CONFIG_IDF_TARGET="esp32s3"

# 提高主频，让 UI 更流畅
CONFIG_ESP_DEFAULT_CPU_FREQ_MHZ_240=y
CONFIG_ESP_DEFAULT_CPU_FREQ_MHZ=240

# 增大 malloc 堆以容纳帧缓冲
CONFIG_ESP_MAIN_TASK_STACK_SIZE=8192

# CST816D 触摸：禁用初始化时读取芯片 ID（CST816D 在未触发触摸中断前不响应 I2C，
# 读 ID 会导致初始化失败）
CONFIG_ESP_LCD_TOUCH_CST816S_DISABLE_READ_ID=y

# LVGL 启用更大的字体（默认只有 14px，放大后发糊）
CONFIG_LV_FONT_MONTSERRAT_10=y
CONFIG_LV_FONT_MONTSERRAT_12=y
CONFIG_LV_FONT_MONTSERRAT_16=y
CONFIG_LV_FONT_MONTSERRAT_20=y
CONFIG_LV_FONT_MONTSERRAT_28=y
CONFIG_LV_FONT_MONTSERRAT_48=y
# 默认使用中文字体（SourceHanSansSC 16 CJK），解决中文乱码
CONFIG_LV_FONT_DEFAULT_SOURCE_HAN_SANS_SC_16_CJK=y

# flash 实际 16MB，扩大 app 分区（WiFi 等组件使固件超过 1MB）
CONFIG_ESPTOOLPY_FLASHSIZE_16MB=y
CONFIG_ESPTOOLPY_FLASHSIZE=16MB
CONFIG_PARTITION_TABLE_CUSTOM=y
CONFIG_PARTITION_TABLE_CUSTOM_FILENAME="partitions.csv"
```
